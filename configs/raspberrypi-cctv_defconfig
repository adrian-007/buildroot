## configs/raspberrypi-cctv_defconfig
```kconfig
BR2_arm=y
BR2_cortex_a7=y
BR2_ARM_FPU_NEON_VFPV4=y
BR2_CCACHE=y
BR2_OPTIMIZE_FAST=y
BR2_ROOTFS_MERGED_USR=y
BR2_TARGET_GENERIC_HOSTNAME="cctv"
BR2_TARGET_GENERIC_ISSUE="Welcome to CCTV"
BR2_TARGET_GENERIC_PASSWD_SHA512=y
BR2_ROOTFS_DEVICE_CREATION_DYNAMIC_MDEV=y
BR2_ROOTFS_DEVICE_TABLE_SUPPORTS_EXTENDED_ATTRIBUTES=y
BR2_TARGET_GENERIC_GETTY_TERM="vt102"
BR2_SYSTEM_ENABLE_NLS=y
BR2_TARGET_TZ_INFO=y
BR2_TARGET_LOCALTIME="Europe/Warsaw"
BR2_ROOTFS_OVERLAY="board/raspberrypi-cctv/rootfs-overlay"
BR2_ROOTFS_POST_BUILD_SCRIPT="board/raspberrypi-cctv/post-build.sh"
BR2_ROOTFS_POST_IMAGE_SCRIPT="board/raspberrypi-cctv/post-image.sh"
BR2_LINUX_KERNEL=y
BR2_LINUX_KERNEL_CUSTOM_TARBALL=y
BR2_LINUX_KERNEL_CUSTOM_TARBALL_LOCATION="https://github.com/raspberrypi/linux/archive/6d68e517b3ec73b08f3af96f5859c5d083b66535.tar.gz"
BR2_LINUX_KERNEL_DEFCONFIG="bcm2709"
BR2_LINUX_KERNEL_CONFIG_FRAGMENT_FILES="board/raspberrypi-cctv/linux.config"
BR2_LINUX_KERNEL_LZO=y
BR2_LINUX_KERNEL_DTS_SUPPORT=y
BR2_LINUX_KERNEL_INTREE_DTS_NAME="bcm2709-rpi-2-b"
BR2_PACKAGE_LINUX_TOOLS_CPUPOWER=y
BR2_PACKAGE_BUSYBOX_CONFIG_FRAGMENT_FILES="board/raspberrypi-cctv/busybox.config"
BR2_PACKAGE_BUSYBOX_SHOW_OTHERS=y
BR2_PACKAGE_BUSYBOX_WATCHDOG=y
BR2_PACKAGE_CAMERA_STREAMER=y
BR2_PACKAGE_CAMERA_STREAMER_SERVICE=y
BR2_PACKAGE_FFMPEG_GPL=y
BR2_PACKAGE_FFMPEG_NONFREE=y
BR2_PACKAGE_FFMPEG_EXTRACONF="--enable-mmal"
BR2_PACKAGE_E2FSPROGS=y
BR2_PACKAGE_E2FSPROGS_E2IMAGE=y
BR2_PACKAGE_E2FSPROGS_FUSE2FS=y
BR2_PACKAGE_E2FSPROGS_RESIZE2FS=y
BR2_PACKAGE_RPI_FIRMWARE=y
BR2_PACKAGE_RPI_FIRMWARE_X=y
BR2_PACKAGE_PARTED=y
BR2_PACKAGE_USB_MODESWITCH_DATA=y
BR2_PACKAGE_JIMTCL=y
BR2_PACKAGE_CA_CERTIFICATES=y
BR2_PACKAGE_CRYPTODEV=y
BR2_PACKAGE_OPENSSL=y
BR2_PACKAGE_LIBOPENSSL_ENGINES=y
BR2_PACKAGE_WIRINGPI=y
BR2_PACKAGE_X264=y
BR2_PACKAGE_X264_CLI=y
BR2_PACKAGE_X265=y
BR2_PACKAGE_X265_CLI=y
BR2_PACKAGE_LIBCURL_VERBOSE=y
BR2_PACKAGE_NCURSES_WCHAR=y
BR2_PACKAGE_HAVEGED=y
BR2_PACKAGE_CONNMAN=y
BR2_PACKAGE_CONNMAN_WIFI=y
BR2_PACKAGE_CONNMAN_LOOPBACK=y
BR2_PACKAGE_CONNMAN_CLIENT=y
BR2_PACKAGE_DROPBEAR=y
# BR2_PACKAGE_DROPBEAR_SMALL is not set
# BR2_PACKAGE_IFUPDOWN_SCRIPTS is not set
BR2_PACKAGE_WIRELESS_TOOLS=y
BR2_PACKAGE_WIRELESS_TOOLS_LIB=y
BR2_PACKAGE_WPA_SUPPLICANT_AUTOSCAN=y
BR2_PACKAGE_WPA_SUPPLICANT_DEBUG_SYSLOG=y
BR2_PACKAGE_WPA_SUPPLICANT_PASSPHRASE=y
BR2_PACKAGE_WPA_SUPPLICANT_DBUS_OLD=y
BR2_PACKAGE_WPA_SUPPLICANT_DBUS_INTROSPECTION=y
BR2_PACKAGE_HTOP=y
BR2_PACKAGE_UTIL_LINUX_BINARIES=y
BR2_PACKAGE_UTIL_LINUX_FSCK=y
BR2_PACKAGE_UTIL_LINUX_MOUNT=y
BR2_PACKAGE_UTIL_LINUX_NOLOGIN=y
BR2_PACKAGE_UTIL_LINUX_WDCTL=y
BR2_PACKAGE_NANO=y
BR2_TARGET_ROOTFS_EXT2=y
BR2_TARGET_ROOTFS_EXT2_4=y
BR2_TARGET_ROOTFS_EXT2_SIZE="256M"
# BR2_TARGET_ROOTFS_TAR is not set
BR2_PACKAGE_HOST_DOSFSTOOLS=y
BR2_PACKAGE_HOST_GENEXT2FS=y
BR2_PACKAGE_HOST_GENIMAGE=y
BR2_PACKAGE_HOST_MKPASSWD=y
BR2_PACKAGE_HOST_MTOOLS=y
```

## package/camera_streamer/Config.in
```kconfig
config BR2_PACKAGE_CAMERA_STREAMER
	bool "camera_streamer"
        select BR2_PACKAGE_LIBCURL
        select BR2_PACKAGE_FFMPEG
        select BR2_PACKAGE_RPI_USERLAND
        select BR2_PACKAGE_BOOST
        select BR2_PACKAGE_BOOST_FILESYSTEM
        select BR2_PACKAGE_BOOST_PROGRAM_OPTIONS
        select BR2_PACKAGE_BOOST_SYSTEM
	help
          Camera Streamer is a set of scripts and a binary program
          that allows creating HLS streams. Scripts are using RaspiVid
          and FFmpeg executables to capture video from camera and
          encapsulate it to MPEG-TS segment files. Those segments
          are saved on predefined location when are picked up by
          camera_streamer executable. Once running, program will
          periodically check video output directory and upload
          video files to remote server (supporting PUT method) from
          newest to oldest.

          FFmpeg is able to upload files on it's own, but it doesn't
          have good congestion control. Camera Streamer on the other
          hand uses filesystem as cache and control current bandwidth
          usage - if we have more time to upload than capture, then
          program will send files from backlog. If backlog grows too
          much, then program will remove redundant files from filesystem
          to save storage space.

if BR2_PACKAGE_CAMERA_STREAMER

config BR2_PACKAGE_CAMERA_STREAMER_SERVICE
      bool "camera_streamer_service"
      help
        Install service files for Camera Streamer

endif
```
